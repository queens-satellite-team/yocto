## build/conf/bblayers.conf
```bitbake
# POKY_BBLAYERS_CONF_VERSION is increased each time build/conf/bblayers.conf
# changes incompatibly
POKY_BBLAYERS_CONF_VERSION = "2"

BBPATH = "${TOPDIR}"
BBFILES ?= ""

BBLAYERS ?= " \
  /home/muhthoff/qset-yocto/layers/poky/meta \
  /home/muhthoff/qset-yocto/layers/poky/meta-poky \
  /home/muhthoff/qset-yocto/layers/poky/meta-yocto-bsp \
  "
```
